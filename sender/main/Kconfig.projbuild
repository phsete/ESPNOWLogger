## sender/main/Kconfig.projbuild
```kconfig
menu "Example Configuration"

    choice ESPNOW_WIFI_MODE
        prompt "WiFi mode"
        default ESPNOW_WIFI_MODE_STATION
        help
            WiFi mode(station or softap).

        config ESPNOW_WIFI_MODE_STATION
            bool "Station"
        config ESPNOW_WIFI_MODE_STATION_SOFTAP
            bool "Softap"
    endchoice

    choice ADC_MODE
        prompt "adc mode"
        default ONESHOT
        help
            Select ADC Mode for ESP32.

        config ONESHOT
            bool "oneshot"
        config CONTINUOUS
            bool "continuous"
    endchoice

    choice EXAMPLE_POWER_SAVE_MODE
        prompt "power save mode"
        default EXAMPLE_POWER_SAVE_MIN_MODEM
        help
            Power save mode for the esp32 to use. Modem sleep mode includes minimum and maximum power save modes.
            In minimum power save mode, station wakes up every DTIM to receive beacon. Broadcast data will not be
            lost because it is transmitted after DTIM. However, it can not save much more power if DTIM is short
            for DTIM is determined by AP.
            In maximum power save mode, station wakes up every listen interval to receive beacon. Broadcast data
            may be lost because station may be in sleep state at DTIM time. If listen interval is longer, more power
            is saved but broadcast data is more easy to lose.

        config EXAMPLE_POWER_SAVE_NONE
            bool "none"
        config EXAMPLE_POWER_SAVE_MIN_MODEM
            bool "minimum modem"
        config EXAMPLE_POWER_SAVE_MAX_MODEM
            bool "maximum modem"
    endchoice

    choice SLEEP_MODE
        prompt "sleep mode"
        default NO_SLEEP
        help
            Select Sleep Mode for ESP32.

        config NO_SLEEP
            bool "no sleep"
        config DEEP_SLEEP
            bool "deep sleep"
    endchoice

    config SLEEP_TIME
        int "Sleep Time"
        default 10
        range 0 1000
        depends on DEEP_SLEEP
        help
            Time Time to sleep [in Seconds]

    choice EXAMPLE_ADC2_CHANNEL
        bool "ADC2 Channel Num"
        default EXAMPLE_ADC2_CHANNEL_7
        help
            The channel of ADC2 used in this example.

        config EXAMPLE_ADC2_CHANNEL_0
            bool "ADC2 Channel 0 (GPIO 11)"
        config EXAMPLE_ADC2_CHANNEL_1
            bool "ADC2 Channel 1 (GPIO 12)"
        config EXAMPLE_ADC2_CHANNEL_2
            bool "ADC2 Channel 2 (GPIO 13)"
        config EXAMPLE_ADC2_CHANNEL_3
            bool "ADC2 Channel 3 (GPIO 14)"
        config EXAMPLE_ADC2_CHANNEL_4
            bool "ADC2 Channel 4 (GPIO 15)"
        config EXAMPLE_ADC2_CHANNEL_5
            bool "ADC2 Channel 5 (GPIO 16)"
        config EXAMPLE_ADC2_CHANNEL_6
            bool "ADC2 Channel 6 (GPIO 17)"
        config EXAMPLE_ADC2_CHANNEL_7
            bool "ADC2 Channel 7 (GPIO 18)"
        config EXAMPLE_ADC2_CHANNEL_8
            bool "ADC2 Channel 8 (GPIO 19)"
        config EXAMPLE_ADC2_CHANNEL_9
            bool "ADC2 Channel 9 (GPIO 20)"
    endchoice

    config EXAMPLE_ADC2_CHANNEL
        int
        default 0 if EXAMPLE_ADC2_CHANNEL_0
        default 1 if EXAMPLE_ADC2_CHANNEL_1
        default 2 if EXAMPLE_ADC2_CHANNEL_2
        default 3 if EXAMPLE_ADC2_CHANNEL_3
        default 4 if EXAMPLE_ADC2_CHANNEL_4
        default 5 if EXAMPLE_ADC2_CHANNEL_5
        default 6 if EXAMPLE_ADC2_CHANNEL_6
        default 7 if EXAMPLE_ADC2_CHANNEL_7
        default 8 if EXAMPLE_ADC2_CHANNEL_8
        default 9 if EXAMPLE_ADC2_CHANNEL_9

    config ESP_LOGGER_VERSION
        string "Installed  ESP Logger Version"
        default "not set"
        help
            This value gets set by the GitHub Action to compile and release a new version, so it can get checked by the code

    config ESPNOW_PMK
        string "ESPNOW primary master key"
        default "pmk1234567890123"
        help
            ESPNOW primary master for the example to use. The length of ESPNOW primary master must be 16 bytes.

    config ESPNOW_LMK
        string "ESPNOW local master key"
        default "lmk1234567890123"
        help
            ESPNOW local master for the example to use. The length of ESPNOW local master must be 16 bytes.

    config ESPNOW_CHANNEL
        int "Channel"
        default 1
        range 0 14
        help
            The channel on which sending and receiving ESPNOW data.

    config ESPNOW_SEND_COUNT
        int "Send count"
        default 100
        range 1 65535
        help
            Total count of unicast ESPNOW data to be sent.

    config ESPNOW_SEND_DELAY
        int "Send delay"
        default 1000
        range 0 65535
        help
            Delay between sending two ESPNOW data, unit: ms.

    config ESPNOW_SEND_LEN
        int "Send len"
        range 10 250
        default 10
        help
            Length of ESPNOW data to be sent, unit: byte.

    config ESPNOW_ENABLE_LONG_RANGE
        bool "Enable Long Range"
        default "n"
        help
            When enable long range, the PHY rate of ESP32 will be 512Kbps or 256Kbps

    config ESPNOW_ENABLE_POWER_SAVE
        bool "Enable ESPNOW Power Save"
        default "n"
        select ESP_WIFI_STA_DISCONNECTED_PM_ENABLE
        depends on ESPNOW_WIFI_MODE_STATION
        help
            With ESPNOW power save enabled, chip would be able to wakeup and sleep periodically
            Notice ESP_WIFI_STA_DISCONNECTED_PM_ENABLE is essential at Wi-Fi disconnected

    config ESPNOW_WAKE_WINDOW
        int "ESPNOW wake window, unit in millisecond"
        range 0 65535
        default 50
        depends on ESPNOW_ENABLE_POWER_SAVE
        help
            ESPNOW wake window

    config ESPNOW_WAKE_INTERVAL
        int "ESPNOW wake interval, unit in millisecond"
        range 1 65535
        default 100
        depends on ESPNOW_ENABLE_POWER_SAVE
        help
            ESPNOW wake interval

endmenu
```
